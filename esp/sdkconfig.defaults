## esp/sdkconfig.defaults
```kconfig
# ============================================================================
#  sdkconfig.defaults — all Kconfig set here (no menuconfig needed).
#  Pure ESP-IDF 5.3.x. Pulled in automatically by the PlatformIO espidf builder.
# ============================================================================

# --- Flash size + custom partition table ------------------------------------
CONFIG_ESPTOOLPY_FLASHSIZE_4MB=y
CONFIG_PARTITION_TABLE_CUSTOM=y
CONFIG_PARTITION_TABLE_CUSTOM_FILENAME="partitions.csv"

# --- Anti-brick OTA rollback -------------------------------------------------
# The bootloader marks a freshly-activated OTA image PENDING_VERIFY and rolls
# back to the previous slot unless the app calls
# esp_ota_mark_app_valid_cancel_rollback() (see src/self_test.c).
CONFIG_BOOTLOADER_APP_ROLLBACK_ENABLE=y
# Keep the bootloader RTC watchdog ON across the trial boot; we additionally arm
# the Task WDT around the self-test (belt and suspenders).
CONFIG_BOOTLOADER_WDT_ENABLE=y

# --- mbedTLS threading -------------------------------------------------------
# On IDF 5.3.x the defaults are THREADING_C=n / THREADING_ALT=y, which races when
# coreMQTT (MQTT task) and the OTA download share one esp-tls/mbedTLS context.
# Force pthread-backed locking.
CONFIG_MBEDTLS_THREADING_C=y
CONFIG_MBEDTLS_THREADING_ALT=n
CONFIG_MBEDTLS_THREADING_PTHREAD=y
CONFIG_PTHREAD_TASK_STACK_SIZE_DEFAULT=8192

# --- TLS: client-only, AWS uses RSA-2048 server / P-256 code-sign ------------
# Keep the INCOMING TLS buffer at the full 16 KB AND statically allocated. The OTA
# HTTPS data path streams from S3, which sends large TLS records and does NOT honor
# the Maximum Fragment Length extension — so the device must be able to receive a
# full 16 KB record. With DYNAMIC/VARIABLE buffer the 16 KB IN buffer is freed and
# re-allocated between reads; the re-grow fails on the first S3 body read under the
# heap fragmentation of the concurrent MQTT session (handshake/headers work because
# it's already allocated then). The OUT buffer stays small (4 KB) to save RAM.
CONFIG_MBEDTLS_SSL_IN_CONTENT_LEN=16384
CONFIG_MBEDTLS_SSL_OUT_CONTENT_LEN=4096
CONFIG_MBEDTLS_ASYMMETRIC_CONTENT_LEN=y
# CONFIG_MBEDTLS_DYNAMIC_BUFFER is not set
# CONFIG_MBEDTLS_SSL_VARIABLE_BUFFER_LENGTH is not set

# --- esp_secure_cert key format --
# Selects which on-flash key format device_iot_default_config() reads, because
# esp_secure_cert_mgr exposes a DIFFERENT read API for each (they're mutually
# exclusive). =n -> plaintext key in the esp_secure_cert partition (cust_flash_tlv;
# the provision-secure-cert.sh default). Set =y to read a DS-peripheral-wrapped key
# (provision with --ds). Must match how the partition was provisioned.
# PRECEDENCE: PlatformIO persists each env's active config in sdkconfig.<env>, which
# OVERRIDES this file once it exists. To switch an env to DS, set =y in that env's
# sdkconfig.<env> (or delete sdkconfig.<env> to re-seed it from here) — editing only
# this file has no effect on an env whose sdkconfig.<env> already pins the key.
CONFIG_ESP_SECURE_CERT_DS_PERIPHERAL=n

# --- Task watchdog: we drive it manually during the self-test ----------------
CONFIG_ESP_TASK_WDT_INIT=n

# --- Stacks / main task ------------------------------------------------------
# app_main drives the initial TLS handshake (mbedTLS RSA/ECDHE verify is
# stack-heavy), so give it room.
CONFIG_ESP_MAIN_TASK_STACK_SIZE=8192
CONFIG_FREERTOS_HZ=1000

# --- Logging -----------------------------------------------------------------
CONFIG_LOG_DEFAULT_LEVEL_INFO=y
CONFIG_LOG_MAXIMUM_LEVEL_DEBUG=y

# --- Crash dump: call-stacks -> coredump partition (retrievable for MQTT) -----
# On a panic an ELF coredump is written to the `coredump` flash partition: the
# crashed task + all task stacks/TCBs — i.e. the call stacks the backtrace is
# unwound from — and the backtrace is also printed to the console. At next boot
# esp_core_dump_image_get() reads it back so it can be forwarded to MQTT, then
# esp_core_dump_image_erase() clears the slot. CAPTURE_DRAM is left OFF, so it is
# the call stacks only, NOT the full RAM/heap. (Caveat: a stack can still hold a
# sensitive local at crash time — pair with Flash Encryption at rest, and redact
# before upload if that matters; or capture only the backtrace PCs, see below.)
CONFIG_ESP_COREDUMP_ENABLE_TO_FLASH=y
CONFIG_ESP_COREDUMP_DATA_FORMAT_ELF=y
CONFIG_ESP_SYSTEM_PANIC_PRINT_REBOOT=y

# --- Newlib: nano printf keeps the binary inside a 1.56 MB slot --------------
CONFIG_NEWLIB_NANO_FORMAT=y

# --- Wi-Fi AP selection (src/Kconfig.projbuild, read by src/wifi.c) -----------
# Scan every channel and associate with the STRONGEST same-SSID AP, so a shared-SSID
# mesh doesn't strand the board on a distant node (weak RSSI -> lost DHCP/DNS UDP ->
# "getaddrinfo() returns 202"). RSSI floor 0 = disabled (set e.g. -70 to refuse weak APs).
CONFIG_APP_WIFI_ALL_CHANNEL_SCAN=y
CONFIG_APP_WIFI_CONNECT_AP_BY_SIGNAL=y
CONFIG_APP_WIFI_SCAN_RSSI_THRESHOLD=0
```

## esp/src/Kconfig.projbuild
```kconfig
# Application Wi-Fi station options (read by src/wifi.c). Kconfig.projbuild puts these
# at the top level of `menuconfig`; values live in sdkconfig.defaults (committed) and
# the generated per-env sdkconfig. Mirrors ESP-IDF's wifi/fast_scan example.
menu "Application Wi-Fi"

    choice APP_WIFI_SCAN_METHOD
        prompt "Wi-Fi scan method"
        default APP_WIFI_ALL_CHANNEL_SCAN
        help
            FAST_SCAN associates with the FIRST SSID match the scan finds — on a mesh /
            multi-AP network (many nodes, one SSID) that is often a distant node (weak
            RSSI -> lost DHCP/DNS UDP -> "getaddrinfo() returns 202"). ALL_CHANNEL_SCAN
            scans every channel and picks the best match per the sort method below.

        config APP_WIFI_FAST_SCAN
            bool "Fast scan (first SSID match)"
        config APP_WIFI_ALL_CHANNEL_SCAN
            bool "All-channel scan (choose best AP)"
    endchoice

    choice APP_WIFI_SORT_METHOD
        prompt "AP preference for all-channel scan"
        default APP_WIFI_CONNECT_AP_BY_SIGNAL
        help
            Among SSID matches (all-channel scan only), which AP to associate with.

        config APP_WIFI_CONNECT_AP_BY_SIGNAL
            bool "Strongest signal (RSSI)"
        config APP_WIFI_CONNECT_AP_BY_SECURITY
            bool "Strongest security (authmode)"
    endchoice

    config APP_WIFI_SCAN_RSSI_THRESHOLD
        int "Minimum AP RSSI to associate, dBm (0 = no threshold)"
        range -127 0
        default 0
        help
            Refuse to associate with an AP weaker than this (dBm); 0 disables the check.
            Caution: too strict a floor means the board won't connect at all when only a
            weak AP is in range.

endmenu
```

## factory/sdkconfig.defaults
```kconfig
# --- nbt factory image config ---

# 4 MB flash
CONFIG_ESPTOOLPY_FLASHSIZE_4MB=y

# Use partitions.csv (factory + ota_0 + ota_1). board_build.partitions in
# platformio.ini only sets the FILENAME; without this choice the build falls back
# to partitions_singleapp.csv (no OTA slots -> recovery OTA has nowhere to write).
CONFIG_PARTITION_TABLE_CUSTOM=y
CONFIG_PARTITION_TABLE_CUSTOM_FILENAME="partitions.csv"

# Recovery OTA is plain HTTP via a raw lwIP socket + esp_ota_* (NOT esp_https_ota /
# esp_http_client), so esp-tls + mbedTLS stay out of the image. Authenticity is the
# Secure Boot signature: verified before the slot is made bootable (when SB is on)
# and re-verified by the bootloader at boot. No trust store, no TLS.

# Captive-portal HTTP server: allow a wildcard catch-all URI handler.
CONFIG_HTTPD_WS_SUPPORT=n

# --- size reduction (recovery image: WiFi + plain HTTP, no TLS actually used) ---
CONFIG_COMPILER_OPTIMIZATION_SIZE=y       # -Os
CONFIG_MBEDTLS_CERTIFICATE_BUNDLE=n       # drop the ~50 KB root-CA bundle (unused: recovery is HTTP)
CONFIG_NEWLIB_NANO_FORMAT=y               # small printf/scanf
CONFIG_LOG_DEFAULT_LEVEL_WARN=y           # drop info/debug log strings
CONFIG_BOOTLOADER_LOG_LEVEL_WARN=y
CONFIG_ESP_WIFI_ENABLE_WPA3_SAE=n         # recovery joins/serves open + WPA2 only
CONFIG_ESP_WIFI_ENABLE_WPA3_OWE_STA=n     # also `select`s ESP_WIFI_MBEDTLS_CRYPTO (the real holdout)
CONFIG_ESP_WIFI_ENABLE_WPS=n
CONFIG_ESP_WIFI_MBEDTLS_CRYPTO=n          # supplicant uses its bundled crypto (WPA2 CCMP/AES is in
                                          # S3 hardware), so with esp-tls already gone mbedTLS can GC
                                          # to ~zero. VERIFY: run `pio run -t size-components` AND
                                          # confirm WPA2 still joins.
CONFIG_COMPILER_OPTIMIZATION_ASSERTIONS_SILENT=y  # no per-assert __FILE__ strings
CONFIG_LWIP_IPV6=n                        # IPv4-only recovery -> ~39 KB smaller lwIP (documented)
CONFIG_LOG_DYNAMIC_LEVEL_CONTROL=n        # ~1 KB
# Optional, bigger but with caveats:
#  - CONFIG_LOG_DEFAULT_LEVEL_NONE=y       drops field logs
#  - VFS trim: CONFIG_VFS_SUPPORT_IO=n (~9 KB) needs CONFIG_LWIP_USE_ONLY_LWIP_SELECT=y so the
#    captive-portal HTTP server's select() keeps working
#  - picolibc: default only on IDF 6.0+; on 5.3.x it's an explicit opt-in and may not beat
#    newlib-nano (already enabled) on the S3 -- don't count on the "~30 KB"

# --- Bootloader GPIO factory-reset entry (optional; configure to your board) ---
# These CONFIG_BOOTLOADER_* options are compiled into the BOOTLOADER binary (flash 0x0),
# NOT into any app image. Holding the pin at boot makes the immutable bootloader erase
# otadata and boot the factory partition. The bootloader is shared by all app partitions
# and is never OTA'd, so it's set once when you flash the bootloader and fixed thereafter
# (keep these settings consistent with the main-app project's bootloader config).
# Verify the exact symbol names against your IDF version before enabling.
# CONFIG_BOOTLOADER_FACTORY_RESET=y
# CONFIG_BOOTLOADER_NUM_PIN_FACTORY_RESET=0
# CONFIG_BOOTLOADER_OTA_DATA_ERASE=y     # clear otadata so the bootloader picks factory
# Leave CONFIG_BOOTLOADER_DATA_FACTORY_RESET empty — no app data needs wiping on reset.

CONFIG_BOOTLOADER_APP_ROLLBACK_ENABLE=y
```

## manual-esp/sdkconfig.defaults
```kconfig
# ============================================================================
#  sdkconfig.defaults — variant B (jobs-esp). Pure ESP-IDF 5.3.x.
#  Same anti-brick / TLS settings as variant C; only the OTA transport changed.
# ============================================================================

# --- Flash size + custom partition table (identical to C for apples-to-apples)
CONFIG_ESPTOOLPY_FLASHSIZE_4MB=y
CONFIG_PARTITION_TABLE_CUSTOM=y
CONFIG_PARTITION_TABLE_CUSTOM_FILENAME="partitions.csv"

# --- Anti-brick OTA rollback ------------------------------------------------
CONFIG_BOOTLOADER_APP_ROLLBACK_ENABLE=y
CONFIG_BOOTLOADER_WDT_ENABLE=y

# --- mbedTLS threading ------------------------------------------------------
# esp-mqtt (its own task) and esp_https_ota (download task) each open a TLS
# session; the IDF 5.3 default (THREADING_ALT=y) races their shared mbedTLS
# globals. Force pthread-backed locking (same hazard as C, different engines).
CONFIG_MBEDTLS_THREADING_C=y
CONFIG_MBEDTLS_THREADING_ALT=n
CONFIG_MBEDTLS_THREADING_PTHREAD=y
CONFIG_PTHREAD_TASK_STACK_SIZE_DEFAULT=8192

# --- TLS buffer tuning ------------------------------------------------------
CONFIG_MBEDTLS_DYNAMIC_BUFFER=y
CONFIG_MBEDTLS_SSL_VARIABLE_BUFFER_LENGTH=y

# --- Task watchdog: armed manually during the self-test ---------------------
CONFIG_ESP_TASK_WDT_INIT=n

# --- Stacks / main task -----------------------------------------------------
CONFIG_ESP_MAIN_TASK_STACK_SIZE=8192
CONFIG_FREERTOS_HZ=1000

# --- Logging ----------------------------------------------------------------
CONFIG_LOG_DEFAULT_LEVEL_INFO=y
CONFIG_LOG_MAXIMUM_LEVEL_DEBUG=y

# --- Coredump to flash ------------------------------------------------------
CONFIG_ESP_COREDUMP_ENABLE_TO_FLASH=y
CONFIG_ESP_COREDUMP_DATA_FORMAT_ELF=y

# --- Newlib nano printf -----------------------------------------------------
CONFIG_NEWLIB_NANO_FORMAT=y
```
